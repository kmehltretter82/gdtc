/dts-v1/;

/ {
    compatible = "example,gdtc";
    #address-cells = <1>;
    #size-cells = <1>;

    chosen {
        bootargs = "console=ttyS0";
    };

    serial@1000 {
        compatible = "ns16550a";
        reg = <0x1000 0x100>;
        clock-frequency = <24000000>;
        status = "okay";
        enabled;
    };
};
