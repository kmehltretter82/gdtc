/dts-v1/;

/ {
    arithmetic = <
        (1 + 2 * 3)
        ((1 + 2) * 3)
        (0x10 << 2)
        (0x80 >> 3)
        (7 / 2)
        (7 % 4)
    >;
    bitwise = <
        (5 & 3)
        (5 | 2)
        (5 ^ 1)
        (~0)
        (-1)
    >;
    comparisons = <
        (!0)
        (!9)
        (2 < 3)
        (3 <= 3)
        (4 > 3)
        (4 >= 5)
        (3 == 3)
        (3 != 3)
        (0 || 5)
        (1 && 2)
    >;
    conditional = <
        (0 ? 10 : 20)
        (1 ? 10 : 20)
        (0 ? 1 : 0 ? 2 : 3)
    >;
    wrap64 = /bits/ 64 <
        (0xffffffffffffffff + 1)
        (1 << 64)
        (0xffffffffffffffff >> 64)
    >;
};
